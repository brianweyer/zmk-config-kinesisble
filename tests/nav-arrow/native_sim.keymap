#include "../kinesis.dtsi"
#include "../../config/kinesisble.keymap"

/* Hold the left thumb nav key and press J: Left arrow */
&kscan { events = <ZMK_MOCK_PRESS(6,5,10) ZMK_MOCK_PRESS(2,7,10) ZMK_MOCK_RELEASE(2,7,10) ZMK_MOCK_RELEASE(6,5,10)>; };
