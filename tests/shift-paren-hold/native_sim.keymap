#include "../kinesis.dtsi"
#include "../../config/kinesisble.keymap"

/* Hold left shift past the tapping term and type Q: shifted Q, no ( */
&kscan { events = <ZMK_MOCK_PRESS(3,0,300) ZMK_MOCK_PRESS(1,1,10) ZMK_MOCK_RELEASE(1,1,10) ZMK_MOCK_RELEASE(3,0,10)>; };
